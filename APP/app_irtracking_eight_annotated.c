/**
 * ============================================================
 * app_irtracking_eight.c  —  八路红外巡线 PID 控制（带详细批注版）
 * ============================================================
 *
 * 【文件说明】
 *   本文件实现了基于八路红外传感器阵列的巡线功能。
 *   使用 PID 算法将传感器偏差转化为左右电机的速度差，
 *   让小车能够自动沿着黑线行驶（白底黑线赛道）。
 *
 * 【硬件原理】
 *   小车底部安装了一排 8 个红外对管传感器，横向排列。
 *   红外发射管发出红外光，接收管检测反射光强度：
 *   - 照到白色地面 → 反射强 → 传感器输出 1
 *   - 照到黑色线条 → 反射弱 → 传感器输出 0
 *
 *   传感器布局（从车头看）：
 *      [x8] [x7] [x6] [x5] [x4] [x3] [x2] [x1]
 *      左←                                  →右
 *        -15   -10   -5    +5   +10   +15   +20  ← 权重（weight）
 *
 *   当黑线在正中间时：x4=0, x5=0，加权平均后误差≈0（直行）
 *   当黑线偏左时     ：x1=0 或 x2=0，加权平均后误差<0（需左转）
 *   当黑线偏右时     ：x7=0 或 x8=0，加权平均后误差>0（需右转）
 *
 * 【PID 在巡线中的作用】
 *   - P（比例）：黑线偏离中心越远，转向力度越大
 *   - I（积分）：如果小车一直偏左，积分项会逐渐增大右转力度
 *   - D（微分）：如果黑线突然弯曲（急弯），微分项提前预判转向
 *
 * ============================================================
 */

#include "app_irtracking_eight.h"

/* ============================================================
 * 巡线 PID 参数定义
 * ------------------------------------------------------------
 * 这些系数决定了小车巡线的"性格"：
 *   - KP 大 → 转弯灵敏但容易摆动
 *   - KD 大 → 转弯平稳但反应可能不够快
 *   - KI 目前为 0（纯 PD 控制，一般巡线不需要积分）
 *
 * IRR_TURN_LIMIT：转向输出的最大限制值，防止转弯过猛
 * ============================================================ */
#define IRTrack_Trun_KP   (-5.50)       // 巡线比例系数（负值表示方向）
#define IRTrack_Trun_KI   (-0.000000)   // 巡线积分系数（当前禁用，纯 PD）
#define IRTrack_Trun_KD   (-1.1000)     // 巡线微分系数
#define IRR_TURN_LIMIT    32            // 转向输出最大限制值

/* ============================================================
 * 转向极性开关
 * ------------------------------------------------------------
 * YB-CVT01 电机通道的转向方向与原始巡线模板的差速方向相反。
 * 这个常量开关允许不改 PID 参数就能翻转转向方向。
 *
 * 值为 -1 时：PID 输出会被反转。
 * 如果发现小车巡线时往反方向跑，改这个值为 1 即可。
 * ============================================================ */
#define IRR_STEERING_POLARITY (-1)

/* ---- 八路红外传感器读数变量 ---- */
u8 x1, x2, x3, x4, x5, x6, x7, x8;  // 8 个传感器的数字量（0/1）

int pid_output_IRR = 0;  // 巡线 PID 的最终输出值
u8 trun_flag = 0;        // 转向标志

int8_t err = 0;          // 当前传感器偏差值（有符号，范围约 -20 ~ +20）

// 巡线速度定义
#define IRR_SPEED        70   // 巡线时的基础速度（速度不要太快，否则容易冲出赛道）
#define IRTrack_Minddle  0    // 巡线偏差的目标值（0 表示黑线在正中间）

/* ============================================================
 * Track_PID() — 巡线 PID 计算（位置式 PD 控制）
 * ------------------------------------------------------------
 * 【核心公式】
 *   转向量 = KP * 偏差 + KI * 积分 + KD * (偏差 - 上次偏差)
 *
 * 【积分限幅】
 *   积分值限制在 ±100 之间，防止积分过度累积导致转向过冲。
 *   注意：当前 KI=0，积分项实际上不生效。
 *
 * 【工作流程】
 *   1. 计算偏差 = 传感器读数（加权平均）- 目标值（0）
 *   2. 累加积分
 *   3. 积分限幅
 *   4. 套用 PID 公式
 *   5. 保存本次偏差供下次使用
 *
 * 【举例】
 *   假设黑线偏左，加权平均 = -15：
 *   error = -15 - 0 = -15
 *   IRTrackTurn = (-5.5)*(-15) + 0 + (-1.1)*(-15 - 0)
 *               = 82.5 + 16.5 = 99（正数 → 右转修正）
 *
 * @param actual_value 传感器加权平均后的位置值
 *                     负值=偏左，正值=偏右，0=居中
 * @return             PID 计算出的转向修正量
 * ============================================================ */
float Track_PID(int8_t actual_value)
{
    float IRTrackTurn = 0;          // 本次 PID 输出
    int8_t error;                   // 当前偏差
    static int8_t error_last = 0;   // 上次偏差（static 保持值跨函数调用不丢失）
    static float IRTrack_Integral;  // 积分累积值（static 保持值）

    // 【第1步】计算偏差 = 实际位置 - 目标位置（目标是0，即正中间）
    error = actual_value - IRTrack_Minddle;

    // 【第2步】积分累加
    IRTrack_Integral += error;

    // 【第3步】积分限幅：限制在 ±100 之间
    // 防止积分项过大导致转向过冲
    if (IRTrack_Integral > 100)
        IRTrack_Integral = 100;
    else if (IRTrack_Integral < -100)
        IRTrack_Integral = -100;

    // 【第4步】PID 核心计算
    // error * KP                → 比例项：偏离越大，修正越强
    // IRTrack_Integral * KI     → 积分项：累计偏差补偿
    // (error - error_last) * KD → 微分项：偏差变化率（"预判"转弯）
    IRTrackTurn = error * IRTrack_Trun_KP
                + IRTrack_Trun_KI * IRTrack_Integral
                + (error - error_last) * IRTrack_Trun_KD;

    // 【第5步】保存本次偏差，供下次调用时作为"上次偏差"使用
    error_last = error;

    return IRTrackTurn;
}

/* ============================================================
 * Copy_HD_Data() — 读取八路红外传感器数据
 * ------------------------------------------------------------
 * 从全局数组 IR_Data_number[8] 中读取 8 个传感器的数字量。
 *
 * IR_Data_number[i] 的含义：
 *   0 = 该传感器检测到黑线（红外光被吸收，反射弱）
 *   1 = 该传感器检测到白色地面（红外光被反射回来）
 *
 * 传感器排列顺序（车头视角）：
 *   x1=最左侧, x2, x3, x4, x5, x6, x7, x8=最右侧
 * ============================================================ */
void Copy_HD_Data()
{
    x1 = IR_Data_number[0];  // 传感器1：最左侧
    x2 = IR_Data_number[1];
    x3 = IR_Data_number[2];
    x4 = IR_Data_number[3];
    x5 = IR_Data_number[4];
    x6 = IR_Data_number[5];
    x7 = IR_Data_number[6];
    x8 = IR_Data_number[7];  // 传感器8：最右侧

    // 以下是 OLED 显示屏调试输出（已注释掉）
    // 可以用来实时查看每个传感器的状态
    // OLED_ShowString(0,25,(uint8_t *)"IR:",8,1);
    // OLED_ShowNum(20 + 1 * 10, 20, x1, 1, 8, 1);
    // ...
}

/* ============================================================
 * LineCheck() — 检测小车当前在黑色还是白色区域
 * ------------------------------------------------------------
 * 判断逻辑：
 *   1. 先读取传感器数据
 *   2. 如果全部8个传感器都是1 → 所有传感器都在白色地面上 → 返回 WHITE_IR
 *   3. 如果8个传感器之和 < 8（即至少有1个是0）→ 检测到黑线 → 返回 BLACK_IR
 *
 * 返回值：
 *   WHITE_IR — 小车完全在白底上（可能已经偏离赛道）
 *   BLACK_IR — 至少有一个传感器检测到黑线
 * ============================================================ */
int LineCheck(void)
{
    IR_DATA();        // 触发一次红外传感器采集
    Copy_HD_Data();   // 把采集到的数据复制到 x1~x8 变量

    // 全部为 1 → 全是白色地面 → 没有黑线
    if (x1 == 1 && x2 == 1 && x3 == 1 && x4 == 1
        && x5 == 1 && x6 == 1 && x7 == 1 && x8 == 1)
    {
        return WHITE_IR;
    }
    // 至少有一个 0 → 检测到黑线
    else if (x1 + x2 + x3 + x4 + x5 + x6 + x7 + x8 < 8)
    {
        return BLACK_IR;
    }
    // 默认认为在白底上
    return WHITE_IR;
}

/* ============================================================
 * Line_Tracke() — 巡线主函数
 * ------------------------------------------------------------
 * 这是巡线算法的核心函数，综合了传感器读取、加权平均计算、
 * PID 控制和电机驱动。
 *
 * 【算法流程】
 *   第1步：读取 8 个红外传感器数据
 *   第2步：加权平均计算黑线位置偏差
 *   第3步：用 PID 计算转向修正量
 *   第4步：限幅后驱动左右电机（差速转向）
 *
 * 【加权平均算法详解】
 *   每个传感器有一个"位置权重"：
 *     x1=-20, x2=-15, x3=-10, x4=-5, x5=+5, x6=+10, x7=+15, x8=+20
 *
 *   只有检测到黑线（值为0）的传感器才参与计算：
 *     weighted_sum = Σ(检测到黑线的传感器权重)
 *     err = weighted_sum / 检测到黑线的传感器数量
 *
 *   举例：
 *     黑线在中间偏左 → x3=0, x4=0 → err = (-10 + -5)/2 = -7.5
 *     → PID 输出正值 → 右轮加速/左轮减速 → 小车向右修正
 *
 *   黑线完全在左边 → 只有 x1=0 → err = -20/1 = -20
 *     → PID 输出大的正值 → 大力右转
 *
 * 【丢失黑线的处理】
 *   如果所有传感器都没有检测到黑线（sensor_active_count == 0），
 *   根据上次偏差的方向继续搜索：
 *     - 上次偏右（err>0）→ 继续右转找线
 *     - 上次偏左（err<0）→ 继续左转找线
 *     - 上次居中（err=0）→ 不动
 *
 * @param state 控制开关：1=启用巡线, 0=只读传感器不控制电机
 * ============================================================ */
void Line_Tracke(int state)
{
    // 【第1步】读取传感器数据
    IR_DATA();        // 触发红外传感器硬件采集
    Copy_HD_Data();   // 复制到 x1~x8 变量

    // 【第2步】加权平均计算黑线位置
    // 权重数组：左负右正，绝对值越大越靠边
    int weights[8] = {-20, -15, -10, -5, 5, 10, 15, 20};
    int weighted_sum = 0;       // 加权和
    int sensor_active_count = 0; // 检测到黑线的传感器数量

    // 遍历 8 个传感器，x==0 表示检测到黑线
    if (x1 == 0) { weighted_sum += weights[0]; sensor_active_count++; }
    if (x2 == 0) { weighted_sum += weights[1]; sensor_active_count++; }
    if (x3 == 0) { weighted_sum += weights[2]; sensor_active_count++; }
    if (x4 == 0) { weighted_sum += weights[3]; sensor_active_count++; }
    if (x5 == 0) { weighted_sum += weights[4]; sensor_active_count++; }
    if (x6 == 0) { weighted_sum += weights[5]; sensor_active_count++; }
    if (x7 == 0) { weighted_sum += weights[6]; sensor_active_count++; }
    if (x8 == 0) { weighted_sum += weights[7]; sensor_active_count++; }

    // 【第3步】计算平均偏差
    if (sensor_active_count > 0)
    {
        // 有传感器检测到黑线 → 用加权平均计算偏差
        // 除以数量是为了排除传感器数量变化对偏差值的干扰
        err = weighted_sum / sensor_active_count;
    }
    else
    {
        // 所有传感器都未检测到黑线 → 小车可能冲出赛道了
        // 根据"上次偏差"推断黑线可能在哪个方向，继续搜索
        if (err > 0)
        {
            err = 20;   // 上次偏右，继续右转寻找黑线
        }
        else if (err < 0)
        {
            err = -20;  // 上次偏左，继续左转寻找黑线
        }
        else
        {
            err = 0;    // 初始状态，不动
        }
    }

    // 【第4步】PID 控制 & 电机驱动
    if (state == 1)   // 启用巡线控制
    {
        // (1) 调用 Track_PID() 计算转向量，乘以极性进行方向修正
        pid_output_IRR = (int)(Track_PID(err) * IRR_STEERING_POLARITY);

        // (2) 输出限幅：限制在 ±IRR_TURN_LIMIT（32）以内
        //     防止转向量过大导致小车失控
        if (pid_output_IRR > IRR_TURN_LIMIT)
            pid_output_IRR = IRR_TURN_LIMIT;
        if (pid_output_IRR < -IRR_TURN_LIMIT)
            pid_output_IRR = -IRR_TURN_LIMIT;

        // (3) 驱动电机：差速转向
        //     左轮 = 基础速度 + 转向修正（偏左时 pid_output_IRR>0，左轮加速右转）
        //     右轮 = 基础速度 - 转向修正（偏左时 pid_output_IRR>0，右轮减速右转）
        //     第三个参数 0 = 不再额外叠加转向
        Set_PID_Motor(IRR_SPEED + pid_output_IRR, IRR_SPEED - pid_output_IRR, 0);
    }
    else   // 不启用巡线控制 → 只读传感器数据，不控制电机
    {
        IR_DATA();        // 再次读取
        Copy_HD_Data();   // 更新数据
    }
}
